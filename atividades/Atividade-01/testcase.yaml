## atividades/Atividade-01/testcase.yaml
```yaml
tests:
  atividade01.hello_world:
    build_only: false
    platform_allow: native_sim
    harness: console
    harness_config:
      type: one_line
      regex:
        - "Hello World! .*"
    tags: atividade01
```

## atividades/Atividade-01/unit/testcase.yaml
```yaml
tests:
  atividade01.unit:
    build_only: false
    platform_allow: native_sim
    tags: atividade01
```
